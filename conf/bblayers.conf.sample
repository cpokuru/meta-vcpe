## conf/bblayers.conf.sample
```bitbake
# POKY_BBLAYERS_CONF_VERSION is increased each time build/conf/bblayers.conf
# changes incompatibly
POKY_BBLAYERS_CONF_VERSION = "2"

BBPATH = "${TOPDIR}"
BBFILES ?= ""

VCPEROOT := "${@os.path.abspath(os.path.dirname(d.getVar('FILE', True)) + '/../..')}"

BBLAYERS ?= " \
  ${VCPEROOT}/meta \
  ${VCPEROOT}/meta-poky \
  ${VCPEROOT}/meta-yocto-bsp \
  ${VCPEROOT}/meta-openembedded/meta-oe \
  ${VCPEROOT}/meta-openembedded/meta-python \
  ${VCPEROOT}/meta-openembedded/meta-networking \
  ${VCPEROOT}/meta-vcpe \
  "
```

## conf/distro/vcpe.conf
```bitbake
require conf/distro/poky.conf

DISTRO = "vcpe"
DISTRO_NAME = "Virtual CPE Distribution"
DISTRO_VERSION = "1.0"
DISTRO_CODENAME = "vcpe"

# Add your distro-specific configurations here

# ----------------------------------------------------------------------

PACKAGE_CLASSES = "package_ipk"

# ----------------------------------------------------------------------

IMAGE_FSTYPES+= "lxd"
IMAGE_FSTYPES:remove = " ext4"

IMAGE_CLASSES += "image_types_lxd"

# ----------------------------------------------------------------------

PREFERRED_PROVIDER_virtual/shell = "bash"
VIRTUAL-RUNTIME_base-utils-shell = "bash"

# ----------------------------------------------------------------------

MACHINE_FEATURES:remove = "kernel"
PREFERRED_PROVIDER_virtual/kernel = "linux-dummy"

# ----------------------------------------------------------------------

IMAGE_CLASSES:remove = "qemuboot"
EXTRA_IMAGEDEPENDS:remove = "qemu-helper-native"
EXTRA_IMAGEDEPENDS:remove = "qemu-system-native"
```

## conf/layer.conf
```bitbake
# We have a conf and classes directory, add to BBPATH
BBPATH .= ":${LAYERDIR}"

# We have recipes-* directories, add to BBFILES
BBFILES += "${LAYERDIR}/recipes-*/*/*.bb \
            ${LAYERDIR}/recipes-*/*/*.bbappend"

BBFILE_COLLECTIONS += "meta-vcpe"
BBFILE_PATTERN_meta-vcpe = "^${LAYERDIR}/"
BBFILE_PRIORITY_meta-vcpe = "6"

LAYERDEPENDS_meta-vcpe = "core"
LAYERSERIES_COMPAT_meta-vcpe = "kirkstone"
```
